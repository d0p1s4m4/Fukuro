## src/kernel/arch/aarch64/Kconfig
```kconfig
menu "AArch64 Architecture"
	depends on AARCH64

	config ARCH
		string
		default "aarch64"

endmenu
```

## src/kernel/arch/x86/Kconfig
```kconfig
menu "x86 architecture"
    depends on X86

    config ARCH
        string
        default "x86"

    config 64BIT
        bool
        prompt "64 Bit"
        default n
    
    config SMP
        bool
        prompt "SMP"
        default n
    
    config PAE
        bool
        prompt "PAE"
        default n
endmenu
```

## test/Kconfig
```kconfig
menu "Test"

config WITH_COVERAGE
	bool "With code coverage"
	default y

endmenu
```
